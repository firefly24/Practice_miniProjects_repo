/dts-v1/;
/plugin/;

/{
    compatible = "linux,dt-overlay";

    fragment@0 {
        target-path = "/pl061@9030000";

        __overlay__ {
            gpio0: /pl061@9030000 {
            };
        };
    };

    fragment@1 {
        target = <&gpio0>;

        __overlay__ {
            led0: led0 {
                compatible = "practice,gpio-led";
                gpios = <&gpio0 5 0>;
                status = "okay";
            };
        };
    };

};

